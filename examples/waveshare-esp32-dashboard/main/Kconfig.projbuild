## examples/waveshare-esp32-dashboard/main/Kconfig.projbuild
```kconfig
menu "Maestra Dashboard Configuration"

    menu "WiFi"
        config MAESTRA_WIFI_SSID
            string "WiFi SSID"
            default "your-wifi-ssid"
            help
                SSID of the WiFi network to connect to.

        config MAESTRA_WIFI_PASSWORD
            string "WiFi Password"
            default "your-wifi-password"
            help
                Password for the WiFi network.

        config MAESTRA_WIFI_MAX_RETRY
            int "Maximum WiFi connect retries"
            default 10
            help
                Number of times to retry WiFi connection before giving up.
    endmenu

    menu "MQTT"
        config MAESTRA_MQTT_BROKER_URI
            string "Maestra MQTT broker URI"
            default "mqtt://192.168.1.100:1883"
            help
                URI of the Mosquitto broker in the Maestra stack.
                Format: mqtt://host:port
    endmenu

    menu "Entities"
        config MAESTRA_ENTITY_SLUG_1
            string "Entity slug 1"
            default "entity-one"
            help
                Slug of the first Maestra entity to display.

        config MAESTRA_ENTITY_SLUG_2
            string "Entity slug 2 (leave blank to skip)"
            default "entity-two"

        config MAESTRA_ENTITY_SLUG_3
            string "Entity slug 3 (leave blank to skip)"
            default "entity-three"

        config MAESTRA_ENTITY_SLUG_4
            string "Entity slug 4 (leave blank to skip)"
            default "entity-four"
    endmenu

endmenu
```

## examples/waveshare-esp32-dashboard/sdkconfig.defaults
```kconfig
# Maestra Dashboard — ESP32-P4 SDK Configuration Defaults
# Based on Waveshare ESP32-P4-WIFI6-Touch-LCD-X reference

CONFIG_IDF_TARGET="esp32p4"

# Flash
CONFIG_ESPTOOLPY_FLASHMODE_QIO=y
CONFIG_ESPTOOLPY_FLASHSIZE_32MB=y
CONFIG_ESPTOOLPY_FLASHSIZE="32MB"
CONFIG_SPI_FLASH_SUPPORT_GD_CHIP=y
CONFIG_PARTITION_TABLE_CUSTOM=y

# PSRAM
CONFIG_SPIRAM=y
CONFIG_SPIRAM_SPEED_200M=y
CONFIG_SPIRAM_XIP_FROM_PSRAM=y

# Cache
CONFIG_CACHE_L2_CACHE_256KB=y
CONFIG_CACHE_L2_CACHE_LINE_128B=y

# Compiler — optimize for size so the binary fits in the 8 MB app partition
CONFIG_COMPILER_OPTIMIZATION_SIZE=y

# FreeRTOS
CONFIG_FREERTOS_HZ=1000
CONFIG_ESP_MAIN_TASK_STACK_SIZE=10240

# LVGL
CONFIG_LV_OS_FREERTOS=y
CONFIG_LV_USE_CLIB_MALLOC=y
CONFIG_LV_USE_CLIB_STRING=y
CONFIG_LV_USE_CLIB_SPRINTF=y
CONFIG_LV_DEF_REFR_PERIOD=15
CONFIG_LV_OBJ_STYLE_CACHE=y
CONFIG_LV_DRAW_SW_DRAW_UNIT_CNT=2
CONFIG_LV_ATTRIBUTE_FAST_MEM_USE_IRAM=y

# LVGL fonts (used by the dashboard UI)
CONFIG_LV_FONT_MONTSERRAT_14=y
CONFIG_LV_FONT_MONTSERRAT_16=y
CONFIG_LV_FONT_MONTSERRAT_18=y
CONFIG_LV_FONT_MONTSERRAT_20=y
CONFIG_LV_FONT_MONTSERRAT_22=y
CONFIG_LV_FONT_MONTSERRAT_26=y

# Spectrum stream
CONFIG_MAESTRA_STREAM_UDP_PORT=9900

# lwIP — enable IP reassembly so large UDP datagrams (e.g. 4 KB SDRF
# spectrum packets) that get fragmented at the network layer are properly
# reassembled before being delivered to the socket.
CONFIG_LWIP_IP4_REASSEMBLY=y
CONFIG_LWIP_IP_REASS_MAX_PBUFS=20

# WiFi — disable SoftAP (we only use STA via ESP32-C6 coprocessor)
CONFIG_ESP_WIFI_SOFTAP_SUPPORT=n

# Disable LVGL built-in demos and examples (saves significant flash)
CONFIG_LV_USE_DEMO_WIDGETS=n
CONFIG_LV_USE_DEMO_MUSIC=n
CONFIG_LV_USE_DEMO_STRESS=n
CONFIG_LV_USE_DEMO_BENCHMARK=n

# Experimental features required for ESP32-P4
CONFIG_IDF_EXPERIMENTAL_FEATURES=y
```
